## main/Kconfig.projbuild
```kconfig
menu "Example Configuration"

    config EXAMPLE_USB_MINIMAL_VALIDATION_MODE
        bool "USB-only minimal validation mode"
        default n
        help
            Start one USB UVC camera without CSI, Wi-Fi, WebSocket, HTTP,
            provisioning, mDNS, or remote logging. A camera connected directly
            to the USB root port is assigned to cam1. Intended for isolating
            USB isochronous transfer stability problems.

    config EXAMPLE_USB_NETWORK_VALIDATION_MODE
        bool "USB Wi-Fi/WebSocket validation mode"
        default n
        help
            Start one USB UVC camera with Wi-Fi and WebSocket transport while
            keeping CSI, HTTP, mDNS, provisioning, and remote UDP logging off.
            Frames are sent to the PC address stored in NVS.

    config EXAMPLE_USB_HUB_VALIDATION_MODE
        bool "Route the single validation camera through the USB HUB"
        depends on EXAMPLE_USB_NETWORK_VALIDATION_MODE
        default n
        help
            Reject a camera connected directly to the USB root port. Map a
            single camera on Waveshare HOST port 2, 3, or 4 to cam1 while keeping the
            Wi-Fi/WebSocket validation configuration unchanged.

    config EXAMPLE_USB_CSI_NETWORK_VALIDATION_MODE
        bool "Enable CSI during USB Wi-Fi/WebSocket validation"
        depends on EXAMPLE_USB_NETWORK_VALIDATION_MODE
        default n
        help
            Start cam0 CSI together with the single cam1 USB stream and send
            both over WebSocket. Cam1 may use the direct Type-A port selected
            by the DEVICE jumper or a CH334 port selected by HOST. HTTP, mDNS,
            provisioning and remote logging remain disabled.

    config EXAMPLE_DUAL_USB_NETWORK_VALIDATION_MODE
        bool "Enable dual USB cameras during Wi-Fi/WebSocket validation"
        depends on EXAMPLE_USB_NETWORK_VALIDATION_MODE
        default n
        help
            Start cam1 and cam2 from any two Waveshare HOST ports 2-4. CSI,
            HTTP, mDNS, provisioning and remote logging remain disabled.
    
    config EXAMPLE_CAMERA_VIDEO_BUFFER_NUMBER
        int "CSI camera video buffer number"
        default 2
        range 2 4
        help
            Number of video buffers for the CSI camera sensor.

            Keep this conservative because 1080p CSI raw/RGB buffers are large.

    config EXAMPLE_USB_CAMERA_VIDEO_BUFFER_NUMBER
        int "USB camera video buffer number"
        default 6
        range 4 10
        help
            Number of V4L2 frame buffers per USB UVC camera.

            Six buffers per stream provide additional scheduling headroom for
            the fixed 60fps MJPEG mode while leaving PSRAM for other camera data.

    config EXAMPLE_USB_UVC_URB_NUMBER
        int "USB UVC in-flight URB number"
        default 4
        range 2 16
        help
            Number of USB transfer requests kept in flight per UVC stream.

            Larger values provide more buffering against ISR/task scheduling
            jitter and can reduce missed EOF/incomplete MJPEG frames. They
            consume additional DMA-capable memory proportional to the URB size.

    config EXAMPLE_JPEG_COMPRESSION_QUALITY
        int "JPEG compression quality (%)"
        default 80
        range 1 100
        help
            JPEG compression quality percentage (1-100).

            Higher values produce better image quality but larger data streams:
            - 90-100: Excellent quality, high bandwidth usage
            - 70-90: Good quality, moderate bandwidth (recommended for UVC)
            - 50-70: Acceptable quality, lower bandwidth
            - 1-50: Poor quality, minimal bandwidth

            For UVC streaming, consider the USB bandwidth limitations
            and host system capabilities when choosing quality level.

            Recommended: 80 for balanced quality and performance.

    config EXAMPLE_MDNS_INSTANCE
        string "mDNS instance"
        default "web-cam"
        help
            mDNS instance name for service discovery.
            
            This name will be used to identify the camera service on the network.
            Other devices can discover this camera using this instance name
            through mDNS/Bonjour protocols.
    
    config EXAMPLE_MDNS_HOST_NAME
        string "mDNS host name"
        default "esp-web"
        help
            mDNS host name for the ESP32 device.
            
            This hostname will be used for network identification and can be
            accessed as "esp-web.local" on the local network (if mDNS is supported
            by the client device).

endmenu

menu "Provisioning Configuration"

    config EXAMPLE_PROVISION_LONG_PRESS_MS
        int "Long-press duration (ms)"
        default 3000
        range 1000 10000
        help
            Duration in milliseconds that the BOOT button (GPIO35) must be held
            continuously to trigger a factory reset and enter AP provisioning mode.

            Shorter values make it easier to trigger accidentally.
            Longer values prevent accidental triggers.

    config EXAMPLE_PROVISION_AP_TIMEOUT_MS
        int "AP provisioning mode watchdog (ms)"
        default 300000
        range 60000 3600000
        help
            If no client connects to the SoftAP within this duration,
            a warning is logged. The AP stays active indefinitely
            so provisioning can still complete at any time.

    config EXAMPLE_PROVISION_STA_MAX_RETRY
        int "STA connection retries before fallback to AP"
        default 5
        range 1 20
        help
            Number of STA connection attempts before giving up and
            falling back to AP provisioning mode.

    config EXAMPLE_PROVISION_AP_SSID_PREFIX
        string "SoftAP SSID prefix for provisioning"
        default "ESP-CAM-PROV-"
        help
            Prefix for the SoftAP SSID during provisioning mode.
            The last 3 bytes of the AP MAC address are appended to
            create a unique SSID (e.g., ESP-CAM-PROV-1A2B3C).

    config EXAMPLE_PROVISION_BUTTON_GPIO
        int "GPIO for long-press provisioning button"
        default 35
        range 0 54
        help
            GPIO pin number for the long-press provisioning button.
            Default is GPIO35, the BOOT button on the Waveshare
            ESP32-P4-WIFI6-DEV-KIT board.

endmenu
```
